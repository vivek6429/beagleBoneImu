## builds/beagleBuild/conf/bblayers.conf
```bitbake
# POKY_BBLAYERS_CONF_VERSION is increased each time build/conf/bblayers.conf
# changes incompatibly
POKY_BBLAYERS_CONF_VERSION = "2"

BBPATH = "${TOPDIR}"
BBFILES ?= ""

BBLAYERS ?= " \
  /home/victor/Projects/yocto/src/poky/meta \
  /home/victor/Projects/yocto/src/poky/meta-poky \
  /home/victor/Projects/yocto/src/poky/meta-yocto-bsp \
  /home/victor/Projects/yocto/src/meta-custom \
  /home/victor/Projects/yocto/src/meta-openembedded/meta-oe \
  /home/victor/Projects/yocto/src/meta-openembedded/meta-python \
  /home/victor/Projects/yocto/src/meta-openembedded/meta-networking \
  "
```

## builds/pi4Build/conf/bblayers.conf
```bitbake
# POKY_BBLAYERS_CONF_VERSION is increased each time build/conf/bblayers.conf
# changes incompatibly
POKY_BBLAYERS_CONF_VERSION = "2"

BBPATH = "${TOPDIR}"
BBFILES ?= ""

BBLAYERS ?= " \
  /home/victor/Projects/yocto/poky/meta \
  /home/victor/Projects/yocto/poky/meta-poky \
  /home/victor/Projects/yocto/poky/meta-yocto-bsp \
  /home/victor/Projects/yocto/meta-raspberrypi \
  /home/victor/Projects/yocto/meta-custom \
  "
```

## src/meta-custom/conf/distro/extendPoky.conf
```bitbake
# use everything from poky
require conf/distro/poky.conf

# distro name to be same as file name
DISTRO = "extendPoky"
DISTRO_NAME = "extendPoky is poky plus meta-custom"


# add systemd as init manager
DISTRO_FEATURES:append = " systemd"
VIRTUAL-RUNTIME_init_manager = "systemd"
DISTRO_FEATURES_BACKFILL_CONSIDERED += "sysvinit"
VIRTUAL-RUNTIME_initscripts = "systemd-compat-units" 

DISTRO_FEATURES:append = " usrmerge allow-root-login ssh-server-dropbear dev-pkgs doc-pkgs bash-completion-pkgs udev" 

# disable some features
DISTRO_FEATURES:remove = "x11 wayland "
# debug-tweaks"  

# set root password to 'pass1234'
INHERIT += "extrausers"
# EXTRA_USERS_PARAMS:append = "usermod -P pass1234 root"
# EXTRA_USERS_PARAMS = "usermod -P pass1234 root;"


# set package management to deb
PACKAGE_CLASSES = "package_deb"
DISTRO_FEATURES:append = " package-management "


# add packages from meta-custom by default
# IMAGE_INSTALL:append = " dtoverlay"
```
